#include <string.h>
#include "ssd1306.h"
#include "board_pins.h"
#include "driver/i2c_master.h"
#include "esp_log.h"

static const char *TAG = "ssd1306";
static i2c_master_bus_handle_t s_bus;
static i2c_master_dev_handle_t s_dev;
static bool s_present = false;
static uint8_t s_fb[OLED_W * OLED_H / 8];   /* 1024 byte framebuffer */

/* Font 5x7 (ASCII 0x20..0x7E), moi ky tu 5 cot. */
static const uint8_t FONT5x7[][5] = {
    {0x00,0x00,0x00,0x00,0x00}, // ' '
    {0x00,0x00,0x5F,0x00,0x00}, // !
    {0x00,0x07,0x00,0x07,0x00}, // "
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    {0x44,0x64,0x54,0x4C,0x44}, // z
};

static esp_err_t oled_cmd(uint8_t c)
{
    uint8_t b[2] = { 0x00, c };   /* 0x00 = control byte: command */
    return i2c_master_transmit(s_dev, b, 2, 100);
}

esp_err_t ssd1306_init(void)
{
    i2c_master_bus_config_t bus = {
        .i2c_port = OLED_I2C_PORT,
        .sda_io_num = PIN_OLED_SDA,
        .scl_io_num = PIN_OLED_SCL,
        .clk_source = I2C_CLK_SRC_DEFAULT,
        .glitch_ignore_cnt = 7,
        .flags.enable_internal_pullup = true,
    };
    if (i2c_new_master_bus(&bus, &s_bus) != ESP_OK) return ESP_FAIL;

    i2c_device_config_t dc = {
        .dev_addr_length = I2C_ADDR_BIT_LEN_7,
        .device_address = OLED_I2C_ADDR,
        .scl_speed_hz = OLED_I2C_HZ,
    };
    if (i2c_master_bus_add_device(s_bus, &dc, &s_dev) != ESP_OK) return ESP_FAIL;

    static const uint8_t init_seq[] = {
        0xAE, 0x20, 0x00, 0xB0, 0xC8, 0x00, 0x10, 0x40, 0x81, 0x7F,
        0xA1, 0xA6, 0xA8, 0x3F, 0xA4, 0xD3, 0x00, 0xD5, 0x80, 0xD9,
        0xF1, 0xDA, 0x12, 0xDB, 0x40, 0x8D, 0x14, 0xAF,
    };
    for (size_t i = 0; i < sizeof(init_seq); i++) {
        if (oled_cmd(init_seq[i]) != ESP_OK) {
            ESP_LOGW(TAG, "OLED khong phan hoi (kiem tra SDA21/SCL22, dia chi 0x3C)");
            return ESP_FAIL;
        }
    }
    s_present = true;
    ssd1306_clear();
    ssd1306_flush();
    ESP_LOGI(TAG, "OLED SSD1306 OK (SDA=%d SCL=%d)", PIN_OLED_SDA, PIN_OLED_SCL);
    return ESP_OK;
}

bool ssd1306_present(void) { return s_present; }

void ssd1306_clear(void) { memset(s_fb, 0, sizeof(s_fb)); }

static void draw_char(int col, int page, char c)
{
    if (page < 0 || page > 7 || col < 0 || col > OLED_W - 6) return;
    int idx = (c < 0x20 || c > 0x7E) ? 0 : (c - 0x20);
    uint8_t *dst = &s_fb[page * OLED_W + col];
    for (int i = 0; i < 5; i++) dst[i] = FONT5x7[idx][i];
    dst[5] = 0x00;   /* khoang cach */
}

void ssd1306_text(int col, int page, const char *s)
{
    int x = col;
    for (; *s && x <= OLED_W - 6; s++, x += 6) draw_char(x, page, *s);
}

void ssd1306_hline(int page)
{
    if (page < 0 || page > 7) return;
    for (int x = 0; x < OLED_W; x++) s_fb[page * OLED_W + x] |= 0x01;
}

void ssd1306_flush(void)
{
    if (!s_present) return;
    for (int page = 0; page < 8; page++) {
        oled_cmd(0xB0 + page);
        oled_cmd(0x00);
        oled_cmd(0x10);
        uint8_t line[1 + OLED_W];
        line[0] = 0x40;   /* control byte: data */
        memcpy(&line[1], &s_fb[page * OLED_W], OLED_W);
        i2c_master_transmit(s_dev, line, sizeof(line), 100);
    }
}
